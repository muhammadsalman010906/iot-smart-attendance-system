// ================================================= L I B R A R Y   I N C L U S I O N   S T A R T S =================================================
#include <WiFi.h>
#include <HTTPClient.h>
#include <time.h>
#include <SPI.h>
#include <MFRC522.h>
#include <Wire.h>
#include <Adafruit_GFX.h>
#include <Adafruit_SH110X.h>

// ================================================= L I B R A R Y   I N C L U S I O N   E N D S =================================================

// ================================================= V A R I A B L E   D E C L A R A T I O N   S T A R T =================================================
#define RF_RST_PIN 5
#define RF_SDA1_PIN 4
#define RF_SDA2_PIN 19
#define RF_SCK_PIN 18
#define RF_MISO_PIN 16
#define RF_MOSI_PIN 17
#define RFID_Readers 2
#define BzPIN 12
#define ReedSW 32
#define Relay 13
#define SCREEN_WIDTH 128 
#define SCREEN_HEIGHT 64 
#define OLED_RESET     0 
byte sdaPins[] = {RF_SDA1_PIN, RF_SDA2_PIN};

// ================================================= V A R I A B L E   D E C L A R A T I O N   E N D S =================================================

// ================================================= S E R V I C E S   I N I T I A L I Z A T I O N   S T A R T S =================================================

Adafruit_SH1106G display = Adafruit_SH1106G(SCREEN_WIDTH, SCREEN_HEIGHT, &Wire, OLED_RESET);
MFRC522 mfrc522[RFID_Readers];

//--- WiFi Configuration ---
const char *ssid = "DoCIT-24G";
const char *password = "123DoCIT$%^";
const char* device_token  = "ac83dbe8d832be56";

// OLED Images for TMUC / DoCIT and WiFi << Provided by TMUC Department of Computing
#define logoDoCIT_width 128
#define logoDoCIT_height 64
const unsigned char PROGMEM logoDoCIT_bits[] = {
0x00,0x00,0x00,0x00,0x00,0x00,0x00,0x00,0x00,0x00,0x00,0x00,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0xff,
0xff,0xff,0xff,0x80,0x00,0x00,0x00,0x1f,0xff,0xff,0xf0,0x3f,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0x00,
0xff,0x80,0x7f,0xc0,0x00,0x00,0x00,0x1f,0xf0,0x1f,0xf0,0x3f,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0x00,
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0x5a,0x30,0xf5,0x13,0xf4,0x7c,0x86,0xd0,0x25,0xaf,0xd0,0x93,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0x00
};

#define embTMUC_width 128
#define embTMUC_height 64
const unsigned char PROGMEM embTMUC_bits[]={
0x00,0x00,0x00,0x00,0x00,0x00,0x03,0xff,0xff,0xf0,0x00,0x00,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0x00,
0x00,0x00,0x00,0x03,0x00,0x00,0x03,0xff,0xff,0xff,0xff,0x00,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0x00,
0x00,0x00,0x00,0x60,0x00,0x00,0x03,0xff,0xff,0xff,0xff,0xf8,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0x00,
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0x00,0x00,0x00,0x00,0xff,0x00,0x03,0xff,0xff,0xf8,0x00,0x00,0x00,0x00,0x00,0x00
};

#define logoTMUC_width 128
#define logoTMUC_height 64
const unsigned char PROGMEM logoTMUC_bits[]={
0x00,0x00,0x00,0x00,0x00,0x00,0x00,0x00,0x00,0x00,0x00,0x00,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0x06,
0x00,0x0f,0x00,0x00,0x7e,0x00,0x03,0xf0,0x01,0xe0,0x00,0x1c,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0x00,
0x00,0x0f,0x00,0x00,0xe1,0xe0,0x38,0x78,0x01,0xe0,0x00,0x1c,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0x06,
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0x00,0x00,0x00,0x00,0x00,0x00,0x00,0x00,0x00,0x00,0x00,0x00,0x00,0x00,0x00,0x00
};

#define Wifi_start_width 54
#define Wifi_start_height 49
const uint8_t PROGMEM Wifi_start_bits[] = {
0x00,0x00,0x00,0x00,0x00,0x00,0x00,0x00,0x00,0x00,0x00,0x00,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0x00
,0x1c,0x00,0x00,0x00,0x00,0x70,0x00,0x38,0x00,0x07,0xc0,0x00,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0x80
,0x00,0x03,0xe0,0x04,0x7f,0xff,0xc0,0x00,0x07,0x80,0x00,0xff,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0xfc
,0x00,0x00,0x3f,0xf3,0xfc,0x07,0xf8,0x00,0x00,0x1f,0xf0,0x7f,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0x00
,0x00,0x00,0x00,0x00,0x00,0x00,0x00
};
#define Wifi_connected_width 63
#define Wifi_connected_height 49
const uint8_t PROGMEM Wifi_connected_bits[] = {
 0x00,0x00,0x00,0x00,0x00,0x00,0x00,0x00,0x00,0x00,0x00,0x00,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0x00
,0x00,0x0f,0xff,0xff,0xff,0xff,0xe0,0x00,0x00,0x3f,0xff,0xc0,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0x7e
,0x78,0x07,0xff,0xc0,0x07,0xff,0xc0,0x3c,0x00,0x0f,0xfc,0x00,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0x00
,0x00,0x00,0x3f,0x80,0x03,0xf8,0x00,0x00,0x00,0x00,0x3f,0x00,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0x00
,0x00,0x00,0x00,0x1f,0xf0,0x00,0x00,0x00,0x00,0x00,0x00,0x0f,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0x00
};


//--- Time Configuration ---
int timezone = 5 * 3600;
int time_dst = 0;
unsigned long previousMillis1 = 0;
unsigned long previousMillis2 = 0;

//--- Web Access Configration ---
String getData, Link;
String OldCardID = "";
String URL = "http://docit.tmuc.edu.pk/docit/webproj/rfid/getdata.php";


// ================================================= S E R V I C E S   I N I T I A L I Z A T I O N   S T A R T S =================================================

// ================================================= S E T U P   I N I T I A L I Z A T I O N   S T A R T S =================================================

void setup() {
  Serial.begin(115200);
  while (!Serial);
  delay(1000);

//--- RFID Process Initialization ---  
  SPI.begin(RF_SCK_PIN, RF_MISO_PIN, RF_MOSI_PIN);
  for (uint8_t RF_Reader = 0; RF_Reader < RFID_Readers; RF_Reader++) {
    mfrc522[RF_Reader].PCD_Init(sdaPins[RF_Reader], RF_RST_PIN);
    Serial.print(F("RF Reader "));
    Serial.print(RF_Reader);
    Serial.print(F(": "));
    mfrc522[RF_Reader].PCD_DumpVersionToSerial();
    // - Add Notification that Readers are working on OLED
  }

//--- OLED Display Initialization ---
  if(!display.begin(0x3C, true)) { // Address 0x3D for 128x64
    Serial.println(F("SH1106 allocation failed"));
    for(;;); // Don't proceed, loop forever
  }  
  
  // Displaying Startup Logos
  display.clearDisplay();
  display.drawBitmap( 0, 0, embTMUC_bits, embTMUC_width, embTMUC_height, SH110X_WHITE);
  display.display();
  delay(2000); // Pause for 2 seconds
  display.clearDisplay();
  display.drawBitmap( 0, 0, logoTMUC_bits, logoTMUC_width, logoTMUC_height, SH110X_WHITE);
  display.display();
  delay(2000); // Pause for 2 seconds
  display.clearDisplay();
  display.drawBitmap( 0, 0, logoDoCIT_bits, logoDoCIT_width, logoDoCIT_height, SH110X_WHITE);
  display.display();
  delay(2000); // Pause for 2 seconds
  display.clearDisplay();
  pinMode(Relay, OUTPUT);
  digitalWrite(Relay, LOW);
  delay(1000);
  digitalWrite(Relay, HIGH);
  delay(1000);
  connectToWiFi();
  configTime(timezone, time_dst, "pool.ntp.org","time.nist.gov");
}

// ================================================= S E T U P   I N I T I A L I Z A T I O N   E N D S =================================================

// ================================================= L O O P   I N I T I A L I Z A T I O N   S T A R T S =================================================
void loop() {
  if(!WiFi.isConnected()){
    connectToWiFi();
  }
  if (millis() - previousMillis1 >= 1000) {
    previousMillis1 = millis();
    display.clearDisplay();
    time_t now = time(nullptr);
    struct tm* p_tm = localtime(&now);
    display.setTextSize(1);             // Normal 2:2 pixel scale
    display.setTextColor(SH110X_WHITE);        // Draw white text
    display.setCursor(10,0);
    display.setTextSize(4);             // Normal 2:2 pixel scale
    display.setTextColor(SH110X_WHITE);        // Draw white text
    display.setCursor(0,21);
    if ((p_tm->tm_hour)<10) {display.print("0");display.print(p_tm->tm_hour);}
    else display.print(p_tm->tm_hour);
    display.print(":");
    if ((p_tm->tm_min)<10) {display.print("0");display.println(p_tm->tm_min);}
    else display.println(p_tm->tm_min);
    display.display();
  }

  if (millis() - previousMillis2 >= 15000) {
    previousMillis2 = millis();
    OldCardID="";
  }
  delay(50);
  String CardID ="";
  for (uint8_t RF_Reader = 0; RF_Reader < RFID_Readers; RF_Reader++) {
    if(mfrc522[RF_Reader].PICC_IsNewCardPresent() && mfrc522[RF_Reader].PICC_ReadCardSerial()) {
      Serial.print(F("RF Reader "));
      Serial.print(RF_Reader);
      Serial.print(F(": Card UID:"));
      dump_byte_array(mfrc522[RF_Reader].uid.uidByte, mfrc522[RF_Reader].uid.size);
      Serial.println();
      Serial.print(F("PICC type: "));
      MFRC522::PICC_Type piccType = mfrc522[RF_Reader].PICC_GetType(mfrc522[RF_Reader].uid.sak);
      Serial.println(mfrc522[RF_Reader].PICC_GetTypeName(piccType));
      
      for(byte i = 0; i < mfrc522[RF_Reader].uid.size; i++){
        CardID += mfrc522[RF_Reader].uid.uidByte[i];
      }
      mfrc522[RF_Reader].PICC_HaltA();
      mfrc522[RF_Reader].PCD_StopCrypto1();
      
      if(CardID == OldCardID ){
        return;
      }
      else{
        OldCardID = CardID;
      }
      SendCardID(CardID);
      CardID = "";
    } 
  }
}

// ================================================= L O O P   I N I T I A L I Z A T I O N   E N D =================================================

// ================================================= S U P P O R T E D   F U N C T I O N S   S T A R T =================================================
void dump_byte_array(byte *buffer, byte bufferSize) {
  for (byte i = 0; i < bufferSize; i++) {
    Serial.print(buffer[i] < 0x10 ? " 0" : " ");
    Serial.print(buffer[i], HEX);
  }
}

void SendCardID( String Card_uid ){
  Serial.println("Sending the Card ID");
  if(WiFi.isConnected()){
    HTTPClient http;
    getData = "?card_uid=" + String(Card_uid) + "&device_token=" + String(device_token);
    Link = URL + getData;
    http.begin(Link);
    int httpCode = http.GET();
    String payload = http.getString();

    //Serial.println(Link);   //Print HTTP return code
    Serial.println(httpCode);   //Print HTTP return code
    Serial.println(Card_uid);     //Print Card ID
    Serial.println(payload);    //Print request response payload

    if (httpCode == 200) {
      if (payload.substring(0, 5) == "login") {
        String user_name = payload.substring(5);
    //  Serial.println(user_name);
        
        display.clearDisplay();
        display.setTextSize(2);             // Normal 2:2 pixel scale
        display.setTextColor(SH110X_WHITE);        // Draw white text
        display.setCursor(15,0);             // Start at top-left corner
        display.print(F("Welcome"));
        display.setCursor(0,20);
        display.print(user_name);
        display.display();
        delay(2000);
      }
      else if (payload.substring(0, 6) == "logout") {
        String user_name = payload.substring(6);
    //  Serial.println(user_name);
        
        display.clearDisplay();
        display.setTextSize(2);             // Normal 2:2 pixel scale
        display.setTextColor(SH110X_WHITE);        // Draw white text
        display.setCursor(10,0);             // Start at top-left corner
        display.print(F("Good Bye"));
        display.setCursor(0,20);
        display.print(user_name);
        display.display();
        delay(2000);
      }
      else if (payload == "succesful") {
        display.clearDisplay();
        display.setTextSize(2);             // Normal 2:2 pixel scale
        display.setTextColor(SH110X_WHITE);        // Draw white text
        display.setCursor(5,0);             // Start at top-left corner
        display.print(F("New Card"));
        display.display();
      }
      else if (payload == "available") {
        display.clearDisplay();
        display.setTextSize(2);             // Normal 2:2 pixel scale
        display.setTextColor(SH110X_WHITE);        // Draw white text
        display.setCursor(5,0);             // Start at top-left corner
        display.print(F("Free Card"));
        display.display();
      }
      delay(100);
      http.end();
    }
  }
}

void connectToWiFi(){
    WiFi.mode(WIFI_OFF);
    delay(1000);
    WiFi.mode(WIFI_STA);
    Serial.print("Connecting to ");
    Serial.println(ssid);
    WiFi.begin(ssid, password);

    display.clearDisplay();
    display.setTextSize(1);             // Normal 1:1 pixel scale
    display.setTextColor(SH110X_WHITE);        // Draw white text
    display.setCursor(0, 0);             // Start at top-left corner
    display.print(F("Connecting to \n"));
    display.setCursor(0, 50);   
    display.setTextSize(2);          
    display.print(ssid);
    display.drawBitmap( 73, 10, Wifi_start_bits, Wifi_start_width, Wifi_start_height, SH110X_WHITE);
    display.display();
    
    while (WiFi.status() != WL_CONNECTED) {
      delay(500);
      Serial.print(".");
    }
    Serial.println("");
    Serial.println("Connected");
    
    display.clearDisplay();
    display.setTextSize(2);             // Normal 1:1 pixel scale
    display.setTextColor(SH110X_WHITE);        // Draw white text
    display.setCursor(8, 0);             // Start at top-left corner
    display.print(F("Connected \n"));
    display.drawBitmap( 33, 15, Wifi_connected_bits, Wifi_connected_width, Wifi_connected_height, SH110X_WHITE);
    display.display();
    
    Serial.print("IP address: ");
    Serial.println(WiFi.localIP());  //IP address assigned to your ESP
    
    delay(1000);
}
// ================================================= S U P P O R T E D   F U N C T I O N S   E N D =================================================
